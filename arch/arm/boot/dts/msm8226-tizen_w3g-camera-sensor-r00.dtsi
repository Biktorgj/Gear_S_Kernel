/*
 * Copyright (c) 2013, The Linux Foundation. All rights reserved.
 *
 * This program is free software; you can redistribute it and/or modify
 * it under the terms of the GNU General Public License version 2 and
 * only version 2 as published by the Free Software Foundation.
 *
 * This program is distributed in the hope that it will be useful,
 * but WITHOUT ANY WARRANTY; without even the implied warranty of
 * MERCHANTABILITY or FITNESS FOR A PARTICULAR PURPOSE.  See the
 * GNU General Public License for more details.
 */
&cci {
	actuator1: qcom,actuator@18 {
		cell-index = <1>;
		reg = <0x18>;
		compatible = "qcom,actuator";
		qcom,cci-master = <0>;
	};

	qcom,camera@0 {
		cell-index = <0>;
		compatible = "qcom,camera";
		reg = <0x6a>;
		qcom,slave-id = <0x6a 0x00 0x8b10>;
		qcom,csiphy-sd-index = <0>;
		qcom,csid-sd-index = <0>;
		qcom,sensor-name = "s5k8b1yx";
		qcom,actuator-src = <&actuator1>;
		cam_vdig-supply = <&pm8226_l26>;
		cam_vio-supply =  <&pm8226_l27>;
		cam_vana-supply = <&pm8226_l18>;
		cam_vaf-supply =  <&pm8226_l28>;
		qcom,cam-vreg-name = "cam_vdig", "cam_vio", "cam_vana", "cam_vaf";
		qcom,cam-vreg-type = <0 0 0 0>;
		qcom,cam-vreg-min-voltage = <1200000 1800000 2800000 2800000>;
		qcom,cam-vreg-max-voltage = <1200000 1800000 2800000 2800000>;
		qcom,cam-vreg-op-mode = <1200000 1800000 2800000 2800000>;
		qcom,gpio-no-mux = <0>;
		gpios = <&msmgpio 26 0>,   /*CAM_MCLK*/
			<&msmgpio 37 0>,   /*CAM_nRST*/
			<&msmgpio 28 0>;   /*CAM_STBY*/
		qcom,gpio-reset = <1>;
		qcom,gpio-standby = <2>;
		qcom,gpio-req-tbl-num = <0 1 2>;
		qcom,gpio-req-tbl-flags = <1 0 0>;
		qcom,gpio-req-tbl-label = "CAMIF_MCLK",
			"CAM_RESET",
			"CAM_STBY";
		qcom,cci-master = <0>;
		status = "ok";
	};
};
