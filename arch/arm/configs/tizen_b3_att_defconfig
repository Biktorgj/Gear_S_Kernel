## drivers/misc/clkmon/Kconfig
```kconfig
config CLK_MON
	bool "Clock Gate Mornitor"
	depends on ARCH_MSM=y
	default y
	help
		Say Y to here to enable Clock Gate Mornitor driver for
		profiling Clock Gating and Power Domains.
```

## drivers/motor/Kconfig
```kconfig
#
# Immersion TouchSense Player driver configuration
#
menuconfig VIBETONZ
	tristate "Vibetonz"
	default n
	help
	Say Y to enable Vibetonz support.
	-------------
	-------------
	-------------
config DC_MOTOR
	tristate "DC_Motor"
	default n
	help
	  Say Y to enable DC Motor

config MOTOR_DRV_MAX77803
	tristate "Maxim MAX77803 motor"
	default n

	depends on MFD_MAX77803

config MOTOR_DRV_MAX77804K
	tristate "Maxim MAX77804K motor"
	default n

	depends on MFD_MAX77804K

config MOTOR_DRV_ISA1400
	tristate "ISA1400 motor"
	default n
	depends on I2C
	help
	  Say Y to enalbe the ISA1400 IC.

config MOTOR_DRV_DRV2603
	tristate "DRV2603 motor"
	default n
	help
	  Say Y to enalbe the DRV2603 IC.

config DRV2604L
        tristate "DRV2604L"
        default n
        depends on MACH_B3
        help
         Say Y to enable DRV2604L.

config REG_DRV2604L
	tristate "DRV2604L REG"
	default n
	help
	 Say Y to enable Sysfs for drv2604L reg

#
# Immersion TouchSense Player driver configuration
#
menuconfig MOTOR_DRV_TSP5000
	tristate "MOTOR_DRV_TSP5000"
	default n
	help
	  Say Y to enable MOTOR_DRV_TSP5000 support.

#
# vibrator controlled by PMIC regualtor configuration
#
menuconfig MSM_VIBRATOR
	tristate "MSM_VIBRATOR"
	default n
	help
	Say Y to enable MSM_VIBRATOR support.

config CONFIG_HAPTIC_ISA1200
	tristate "ISA1200 motor"
	default n
	depends on I2C
	help
	  Say Y to enable the ISA1200 IC.

config MOTOR_INFO
	tristate "PRODUCT NAME OF MOTOR"
	default n
	help
	 Say Y to know about motor name

config USING_HW_I2C_DRV2604L
	tristate "DRV2604L USING HW I2C"
	default n
	depends on DRV2604L
	help
	 Say Y to enable hw i2c between drv2604 and ap.
```

## drivers/video/msm_pontesolo_orig/mdss/Kconfig
```kconfig
config FB_MSM_MDSS_WRITEBACK
	bool "MDSS Writeback Panel"
	---help---
	The MDSS Writeback Panel provides support for routing the output of
	MDSS frame buffer driver and MDP processing to memory.

config FB_MSM_MDSS_HDMI_PANEL
	depends on FB_MSM_MDSS
	bool "MDSS HDMI Tx Panel"
	default n
	---help---
	The MDSS HDMI Panel provides support for transmitting TMDS signals of
	MDSS frame buffer data to connected hdmi compliant TVs, monitors etc.

config FB_MSM_MDSS_HDMI_MHL_SII8334
	depends on FB_MSM_MDSS_HDMI_PANEL
	bool 'MHL SII8334 support '
	default n
	---help---
	  Support the HDMI to MHL conversion.
	  MHL (Mobile High-Definition Link) technology
	  uses USB connector to output HDMI content

config FB_MSM_MDSS_DSI_CTRL_STATUS
	tristate "DSI controller status check feature"
	---help---
	  Check DSI controller status periodically (default period is 5
	  seconds) by sending Bus-Turn-Around (BTA) command. If DSI controller
	  fails to acknowledge the BTA command, it sends PANEL_ALIVE=0 status
	  to HAL layer to reset the controller.

config FB_MSM_MDSS_FAKE_RES
	depends on FB_MSM_MDSS
	bool "Support fake resolution"
	default n
	---help---
	  Support fake resolution, it can be supported various resolution by
	  sub xres, yres configuration.

config FB_MSM_MDSS_FAKE_XRES
	depends on FB_MSM_MDSS_FAKE_RES
	int "Support fake xres"
	default 1280
	---help---
	  Support fake xres information. but it only supports up to
	  1280 x 1920 resolution for video panel.

config FB_MSM_MDSS_FAKE_YRES
	depends on FB_MSM_MDSS_FAKE_RES
	int "Support fake yres"
	default 1920
	---help---
	  Support fake yres information. but it only supports up to
	  1280 x 1920 resolution for video panel.

config FB_MSM_MDSS_MDP3
	depends on FB_MSM_MDSS
	bool "MDP3 display controller"
	---help---
	The MDP3 provides support for an older version display controller
	included in latest display sub-system, known as MDSS.

config FB_MSM_MDSS_SAMSUNG_OLED_PANEL
	bool "MDSS_SAMSUNG_OLED_PANEL"
	default n
	---help---
	MDSS Samsung OLED Panel support

config FB_MSM_MDSS_SDC_S6E63J0X03_PANEL
	depends on FB_MSM_MDSS_SAMSUNG_OLED_PANEL
	bool "MDSS_SAMSUNG_OLED_S6E63J0X03_320P_PANEL"
	default n
	---help---
	MDSS Samsung OLED 320P Panel support

config FB_MSM_MDSS_SDC_S6E36W0X01_PANEL
	depends on FB_MSM_MDSS_SAMSUNG_OLED_PANEL
	bool "MDSS_SAMSUNG_OLED_S6E36W0X01_360P_PANEL"
	default n
	---help---
	MDSS Samsung OLED 360P Panel support

config ESD_ERR_FG_RECOVERY
	bool "MDSS_SAMSUNG_OLED_PANEL_ESD_PROTECTION"
	default n
	---help---
	MDSS Samsung OLED Panel ESD protection support
```
